
#include <Adafruit_GFX.h>
#include <Adafruit_SSD1306.h>

#define FACE_WIDTH 128   // OLED face width
#define FACE_HEIGHT 64   // OLED face height
#define MOUTH_WIDTH 128  // OLED display width, in pixels
#define MOUTH_HEIGHT 32  // OLED display height, in pixels
#define FACE_RESET -1
#define MOUTH_RESET -1
#define MOUTH_ADDRESS 0x3C  ///< See datasheet for Address; 0x3D for 128x64, 0x3C for 128x32
#define FACE_ADDRESS 0x3D   ///< See datasheet for Address; 0x3D for 128x64, 0x3C for 128x32

Adafruit_SSD1306 face(FACE_WIDTH, FACE_HEIGHT, &Wire, FACE_RESET);

Adafruit_SSD1306 display(MOUTH_WIDTH, MOUTH_HEIGHT, &Wire, MOUTH_RESET);

unsigned long preFaceMillis = 0;  // time when the current image was faceed
const long faceInterval = 500;    // faceInterval between displaying images (in milliseconds)
byte currentImage = 0;            // index of the current image (0 or 1)


//Function declarations

void faceSetup();
void report(String news, String topic);
void centralText(String text);

// print on Face character by character, line by line.
void showNews(String news);
void showNews(int value);
void showNews(float value);
void showFace(const unsigned char* image);
void blinkEyes();

// Print on the mouth
void displayTime();
void sayTopic(String topic, int textSize);
void sayTopic(int topic, int textSize);
void sayTopic(float topic, int textSize);
void displayTime(int date, String day, int hour, int min);


// TODO: create more images for animations

static const unsigned char PROGMEM distress[] = {
  // ARRAY for DISTRESSED_EYES
  0x00,
  0x00,
  0x00,
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  0x00,
};

static const unsigned char PROGMEM front[] = {
  // ARRAY for 2nd Array EYES_FRONT
  0x00,
  0x00,
  0x00,
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  0x00,
};

static const unsigned char PROGMEM up[] = {
  // 07 ARRAY for EYES_UP
  0x00,
  0x00,
  0x00,
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  0x00,
};

const unsigned char PROGMEM left[] = {
  // 08 ARRAY for EYES_RIGHT
  0x00,
  0x00,
  0x00,
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  0x00,
};

const unsigned char PROGMEM right[] = {
  // 11 ARRAY for EYES_LEFT
  0x00,
  0x00,
  0x00,
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  0x00,
};

const unsigned char PROGMEM confused[] = {
  // 14 ARRAY for CONFUSSED_1
  0x00,
  0x00,
  0x00,
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  0x00,
};

const unsigned char PROGMEM sleepy[] = {
  // 21 ARRAY for EYES_SLEEP
  0x00,
  0x00,
  0x00,
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  0x00,
};

const unsigned char PROGMEM mad[] = {
  // 19 ARRAY for EYES_MAD
  0x00,
  0x00,
  0x00,
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  0x00,
};

const unsigned char PROGMEM glare[] = {
  // 18 ARRAY for EYES_GLARE
  0x00,
  0x00,
  0x00,
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  0x00,
};

const unsigned char PROGMEM cry[] = {
  // 16 ARRAY for EYES_CRY
  0x00,
  0x00,
  0x00,
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  0x00,
};

bool loud = 0;


//FUNCTION DEFINITIONS

void faceSetup() {
  // initialize the SSD1306
  if (!face.begin(SSD1306_SWITCHCAPVCC, FACE_ADDRESS)) {
    for (;;)
      ;
  }

  // SSD1306_SWITCHCAPVCC = generate display voltage from 3.3V internally
  if (!display.begin(SSD1306_SWITCHCAPVCC, MOUTH_ADDRESS)) {
    for (;;)
      ;  // Don't proceed, loop forever
  }

  display.setRotation(2);
  display.clearDisplay();
  face.clearDisplay();
}

void showFace(const unsigned char* image) {
  face.clearDisplay();
  face.drawBitmap((FACE_WIDTH - 128) / 2, (FACE_HEIGHT - 64) / 2, image, 128, 64, 1);
  face.display();
}
void blinkEyes() {  // Blocking code to wink

  face.clearDisplay();
  // draw the current image
  face.drawBitmap(0, 0, front, FACE_WIDTH, FACE_HEIGHT, WHITE);
  // update the display
  face.display();
  delay(200);

  face.clearDisplay();
  // draw the current image
  face.drawBitmap(0, 0, sleepy, FACE_WIDTH, FACE_HEIGHT, WHITE);
  // update the display
  face.display();
  delay(200);
  
  face.clearDisplay();
  // draw the current image
  face.drawBitmap(0, 0, front, FACE_WIDTH, FACE_HEIGHT, WHITE);
  // update the display
  face.display();
  delay(200);

}
// Mouth displays on a single line centered
void report(String news, String topic) {
  // Print on the mouth
  sayTopic(topic, 2);
  // print on Face character by character, line by line.
  showNews(news);
}

void showNews(String news) {
  // print on Face character by character, line by line.
  face.clearDisplay();
  face.setCursor(0, 1);
  face.setTextSize(1);       // Set text size to original size
  face.setTextColor(WHITE);  // Draw white text

  int textLength = news.length();
  int lineLength = 0;

  for (int i = 0; i < textLength; i++) {
    if (lineLength >= FACE_WIDTH / 6) {  // 6 pixels per character
      face.println();
      lineLength = 0;
    }

    face.write(news[i]);
    face.display();
    delay(10);
    lineLength++;
  }
}
void showNews(int news) {
  showNews(String(news));
}
void showNews(float news) {
  showNews(String(news));
}

void sayTopic(String topic, int textSize) {
  display.clearDisplay();
  display.setTextColor(SSD1306_WHITE);
  display.setTextSize(textSize);  // Draw 2X-scale text
  centralText(topic);
  display.display();
}
void sayTopic(int topic, int textSize) {
  sayTopic(String(topic), textSize);
}
void sayTopic(float topic, int textSize) {
  sayTopic(String(topic), textSize);
}

void addNews(String news) {
  int textLength = news.length();
  int lineLength = 0;

  for (int i = 0; i < textLength; i++) {
    if (lineLength >= FACE_WIDTH / 6) {  // 6 pixels per character
      face.println();
      lineLength = 0;
    }

    face.write(news[i]);
    face.display();
    delay(10);
    lineLength++;
  }
}
void displayTime(int date, String day, int hour, int min) {
  display.clearDisplay();
  display.drawRoundRect(86, 0, 34, 32, 3, SSD1306_WHITE);
  display.setTextSize(1);               // Normal 1:1 pixel scale
  display.setTextColor(SSD1306_WHITE);  // Draw white text
  display.setCursor(94, 4);             // Start at top-left corner
  display.print(day);
  display.setCursor(92, 15);
  display.setTextSize(2);
  display.print(date);
  display.setCursor(18, 8);
  display.setTextSize(2);
  if (hour < 10) display.print("0");
  display.print(hour);
  display.print(":");
  if (min < 10) display.print("0");
  display.print(min);
  display.display();
}
void centralText(String text) {  //Centers a string of text. Custom screen size 32 Non blocking
  int16_t x1;
  int16_t y1;
  uint16_t width;
  uint16_t height;

  display.getTextBounds(text, 0, 0, &x1, &y1, &width, &height);
  display.setCursor((MOUTH_WIDTH - width) / 2, (MOUTH_HEIGHT - height) / 2);
  display.println(text);  // text to display
}